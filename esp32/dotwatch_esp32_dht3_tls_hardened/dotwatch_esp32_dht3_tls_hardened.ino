#include <Arduino.h>
/*
  dotWatch ESP32-DHT3 Hardened Firmware
  Phase 4F

  This firmware is for the additional model:
    model_key  = esp32_dht3
    model_name = ESP32-DHT3

  It does NOT replace Raspberry Pi / DW20CH.

  Metrics:
    metric_1 = Temperature (°C)
    metric_2 = Humidity (%)
    metric_3 = WiFi RSSI (dBm)

  Setup portal:
    SSID: dotWatch-ESP32-Setup
    URL : http://192.168.4.1/

  Phase 4F hardening:
    - No hardcoded Wi-Fi/device secret
    - Config stored in ESP32 Preferences/NVS
    - Status LED
    - BOOT long-press reset config
    - Wi-Fi reconnect and self-recovery restart
    - Last send/error snapshot in portal and JSON
    - Numeric metric payload

  Phase 4H local admin:
    - Local web admin over normal Wi-Fi IP
    - PIN-protected config changes on LAN
    - Edit Wi-Fi/backend/device/DHT settings without factory reset

  Phase 5A TLS hardening:
    - Optional Root CA certificate from Local Admin Portal
    - Uses setCACert() when Root CA is configured
    - Production default blocks insecure TLS fallback when Root CA is empty

  Phase 10B TLS CA provisioning:
    - Supports embedded Root CA generated by scripts/phase10b-esp32-install-root-ca.ps1
    - Portal Root CA overrides embedded Root CA when configured
    - Keeps production HTTPS verification on by default
*/

#include <WiFi.h>
#include <WebServer.h>
#include <DNSServer.h>
#include <HTTPClient.h>
#include <WiFiClientSecure.h>
#include <ArduinoJson.h>
#include <DHT.h>
#include <Preferences.h>
#include <time.h>
#include <math.h>
#include <string.h>
#include "dotwatch_root_ca.h"

#define FIRMWARE_VERSION "esp32-dht3-security-1.0.0"

static const char *SETUP_AP_SSID = "dotWatch-ESP32-Setup";
static const char *SETUP_AP_PASSWORD = "dotwatch-setup";
#ifndef DOTWATCH_ALLOW_INSECURE_TLS_FALLBACK
#define DOTWATCH_ALLOW_INSECURE_TLS_FALLBACK 0
#endif
static const byte DNS_PORT = 53;

static const int DEFAULT_DHT_PIN = 4;
static const int DEFAULT_DHT_TYPE = DHT11;
static const unsigned long DEFAULT_SEND_INTERVAL_MS = 20000;
static const unsigned long MIN_SEND_INTERVAL_MS = 10000;

static const unsigned long WIFI_CONNECT_TIMEOUT_MS = 20000;
static const unsigned long WIFI_CONNECT_TOTAL_TIMEOUT_MS = 30000;
static const unsigned long WIFI_PROFILE_ATTEMPT_TIMEOUT_MS = 12000;
static const int WIFI_PROFILE_MAX = 5;
static const char *WIFI_PROFILES_KEY = "wifiProfiles";
static const unsigned long PORTAL_RETRY_WIFI_MS = 30000;
static const unsigned long WIFI_RESTART_AFTER_MS = 10UL * 60UL * 1000UL;
static const unsigned long SEND_RESTART_AFTER_MS = 30UL * 60UL * 1000UL;

static const int STATUS_LED_PIN = 2;
static const int RESET_BUTTON_PIN = 0;
static const unsigned long RESET_HOLD_MS = 6000;

Preferences prefs;
WebServer server(80);
DNSServer dnsServer;
DHT *dht = nullptr;

struct Config {
  String wifiSsid;
  String wifiPassword;
  String apiUrl;
  String deviceCode;
  String deviceSecret;
  String adminPin;
  String tlsCaCert;
  int dhtPin;
  int dhtType;
  unsigned long sendIntervalMs;
  bool fallbackDummy;
};

Config cfg;

struct WiFiProfile {
  String ssid;
  String password;
  int rssi;
  bool primary;
};

bool portalMode = false;
bool ledState = false;

unsigned long lastSendAt = 0;
unsigned long lastWifiRetryAt = 0;
unsigned long wifiDisconnectedSince = 0;
unsigned long lastSuccessfulSendAt = 0;
unsigned long lastLedBlinkAt = 0;
unsigned long resetButtonPressedAt = 0;

String lastSendStatus = "not_sent_yet";
String lastSendError = "";
int lastHttpStatus = 0;
unsigned long totalSendOk = 0;
unsigned long totalSendFail = 0;

String htmlEscape(String input) {
  input.replace("&", "&amp;");
  input.replace("<", "&lt;");
  input.replace(">", "&gt;");
  input.replace("\"", "&quot;");
  input.replace("'", "&#39;");
  return input;
}

String normalizeApiUrl(String value) {
  value.trim();
  while (value.endsWith("/")) value.remove(value.length() - 1);
  if (value.length() == 0) value = "https://dotwatch-backend.onrender.com";
  return value;
}

String maskSecret(const String &secret) {
  if (secret.length() == 0) return "Not set";
  if (secret.length() <= 8) return "********";
  return secret.substring(0, 4) + "********" + secret.substring(secret.length() - 4);
}

bool hasTlsCaCert() {
  return cfg.tlsCaCert.length() > 0;
}

bool hasEmbeddedTlsCaCert() {
  return strlen(DOTWATCH_EMBEDDED_ROOT_CA) > 0;
}

bool hasEffectiveTlsCaCert() {
  return hasTlsCaCert() || hasEmbeddedTlsCaCert();
}

const char *effectiveTlsCaCert() {
  if (hasTlsCaCert()) return cfg.tlsCaCert.c_str();
  return DOTWATCH_EMBEDDED_ROOT_CA;
}

String tlsCaCertSourceText() {
  if (hasTlsCaCert()) return "portal";
  if (hasEmbeddedTlsCaCert()) return "embedded";
  return "none";
}

String tlsModeText() {
  if (hasTlsCaCert()) {
    return "Root CA enabled (portal)";
  }

  if (hasEmbeddedTlsCaCert()) {
    return "Root CA enabled (embedded)";
  }

#if DOTWATCH_ALLOW_INSECURE_TLS_FALLBACK
  return "Insecure fallback enabled";
#else
  return "TLS CA required";
#endif
}

String uptimeText() {
  unsigned long sec = millis() / 1000;
  unsigned long days = sec / 86400;
  sec %= 86400;
  unsigned long hours = sec / 3600;
  sec %= 3600;
  unsigned long minutes = sec / 60;
  sec %= 60;

  String out = "";
  if (days > 0) out += String(days) + "d ";
  if (hours > 0 || days > 0) out += String(hours) + "h ";
  out += String(minutes) + "m " + String(sec) + "s";
  return out;
}

void setLed(bool on) {
  digitalWrite(STATUS_LED_PIN, on ? HIGH : LOW);
  ledState = on;
}

void blinkLed(unsigned long intervalMs) {
  if (millis() - lastLedBlinkAt >= intervalMs) {
    lastLedBlinkAt = millis();
    setLed(!ledState);
  }
}

void recordSendOk(int httpStatus) {
  lastHttpStatus = httpStatus;
  lastSendStatus = "ok";
  lastSendError = "";
  lastSuccessfulSendAt = millis();
  totalSendOk++;
}

void recordSendFail(int httpStatus, const String &error) {
  lastHttpStatus = httpStatus;
  lastSendStatus = "error";
  lastSendError = error;
  totalSendFail++;
}

void clearConfig() {
  prefs.begin("dotwatch", false);
  prefs.clear();
  prefs.end();
}

void loadConfig() {
  prefs.begin("dotwatch", true);
  cfg.wifiSsid = prefs.getString("wifiSsid", "");
  cfg.wifiPassword = prefs.getString("wifiPass", "");
  cfg.apiUrl = normalizeApiUrl(prefs.getString("apiUrl", "https://dotwatch-backend.onrender.com"));
  cfg.deviceCode = prefs.getString("devCode", "");
  cfg.deviceSecret = prefs.getString("devSecret", "");
  cfg.adminPin = prefs.getString("adminPin", "");
  cfg.tlsCaCert = prefs.getString("tlsCaCert", "");
  cfg.dhtPin = prefs.getInt("dhtPin", DEFAULT_DHT_PIN);
  cfg.dhtType = prefs.getInt("dhtType", DEFAULT_DHT_TYPE);
  cfg.sendIntervalMs = prefs.getULong("sendMs", DEFAULT_SEND_INTERVAL_MS);
  cfg.fallbackDummy = prefs.getBool("dummy", true);
  prefs.end();

  if (cfg.dhtPin < 0 || cfg.dhtPin > 39) cfg.dhtPin = DEFAULT_DHT_PIN;
  if (cfg.dhtType != DHT11 && cfg.dhtType != DHT22) cfg.dhtType = DEFAULT_DHT_TYPE;
  if (cfg.sendIntervalMs < MIN_SEND_INTERVAL_MS) cfg.sendIntervalMs = MIN_SEND_INTERVAL_MS;
}

void saveConfig(const Config &next) {
  prefs.begin("dotwatch", false);
  prefs.putString("wifiSsid", next.wifiSsid);
  prefs.putString("wifiPass", next.wifiPassword);
  prefs.putString("apiUrl", normalizeApiUrl(next.apiUrl));
  prefs.putString("devCode", next.deviceCode);
  prefs.putString("devSecret", next.deviceSecret);
  prefs.putString("adminPin", next.adminPin);
  prefs.putString("tlsCaCert", next.tlsCaCert);
  prefs.putInt("dhtPin", next.dhtPin);
  prefs.putInt("dhtType", next.dhtType);
  prefs.putULong("sendMs", next.sendIntervalMs);
  prefs.putBool("dummy", next.fallbackDummy);
  prefs.end();
}

int appendWiFiProfile(WiFiProfile profiles[], int count, String ssid, String password, bool primary = false) {
  ssid.trim();
  if (ssid.length() == 0) return count;

  for (int i = 0; i < count; i++) {
    if (profiles[i].ssid == ssid) {
      if (password.length() > 0 || profiles[i].password.length() == 0) {
        profiles[i].password = password;
      }
      profiles[i].primary = profiles[i].primary || primary;
      return count;
    }
  }

  if (count >= WIFI_PROFILE_MAX) return count;

  profiles[count].ssid = ssid;
  profiles[count].password = password;
  profiles[count].rssi = -999;
  profiles[count].primary = primary;
  return count + 1;
}

int loadWiFiProfiles(WiFiProfile profiles[], int maxProfiles) {
  int count = 0;

  if (cfg.wifiSsid.length() > 0) {
    count = appendWiFiProfile(profiles, count, cfg.wifiSsid, cfg.wifiPassword, true);
  }

  prefs.begin("dotwatch", true);
  String stored = prefs.getString(WIFI_PROFILES_KEY, "");
  prefs.end();

  if (stored.length() > 0) {
    StaticJsonDocument<1536> doc;
    DeserializationError error = deserializeJson(doc, stored);
    if (!error && doc.is<JsonArray>()) {
      JsonArray arr = doc.as<JsonArray>();
      for (JsonObject item : arr) {
        if (count >= maxProfiles) break;
        String ssid = item["s"] | "";
        String password = item["p"] | "";
        count = appendWiFiProfile(profiles, count, ssid, password, false);
      }
    }
  }

  return count;
}

void saveWiFiProfiles(WiFiProfile profiles[], int count) {
  StaticJsonDocument<1536> doc;
  JsonArray arr = doc.to<JsonArray>();

  for (int i = 0; i < count && i < WIFI_PROFILE_MAX; i++) {
    if (profiles[i].ssid.length() == 0) continue;
    JsonObject item = arr.createNestedObject();
    item["s"] = profiles[i].ssid;
    item["p"] = profiles[i].password;
  }

  String out;
  serializeJson(doc, out);

  prefs.begin("dotwatch", false);
  prefs.putString(WIFI_PROFILES_KEY, out);
  prefs.end();
}

void rememberWiFiProfile(String ssid, String password) {
  ssid.trim();
  if (ssid.length() == 0) return;

  WiFiProfile profiles[WIFI_PROFILE_MAX];
  int count = 0;
  count = appendWiFiProfile(profiles, count, ssid, password, true);

  prefs.begin("dotwatch", true);
  String stored = prefs.getString(WIFI_PROFILES_KEY, "");
  prefs.end();

  if (stored.length() > 0) {
    StaticJsonDocument<1536> doc;
    DeserializationError error = deserializeJson(doc, stored);
    if (!error && doc.is<JsonArray>()) {
      JsonArray arr = doc.as<JsonArray>();
      for (JsonObject item : arr) {
        if (count >= WIFI_PROFILE_MAX) break;
        String savedSsid = item["s"] | "";
        String savedPassword = item["p"] | "";
        count = appendWiFiProfile(profiles, count, savedSsid, savedPassword, false);
      }
    }
  }

  saveWiFiProfiles(profiles, count);
}

void persistConnectedWiFiProfile(const WiFiProfile &profile) {
  // Keep the network selected by the user as the primary profile.
  // A remembered backup may be used temporarily when the primary network is unavailable,
  // but it must not silently replace the user's selected Wi-Fi configuration.
  if (!profile.primary) {
    Serial.print("Connected using backup Wi-Fi; primary remains: ");
    Serial.println(cfg.wifiSsid);
    return;
  }

  cfg.wifiSsid = profile.ssid;
  cfg.wifiPassword = profile.password;

  prefs.begin("dotwatch", false);
  prefs.putString("wifiSsid", cfg.wifiSsid);
  prefs.putString("wifiPass", cfg.wifiPassword);
  prefs.end();

  rememberWiFiProfile(cfg.wifiSsid, cfg.wifiPassword);
}

int knownWiFiProfileCount() {
  WiFiProfile profiles[WIFI_PROFILE_MAX];
  return loadWiFiProfiles(profiles, WIFI_PROFILE_MAX);
}

String knownWiFiProfileSummary() {
  WiFiProfile profiles[WIFI_PROFILE_MAX];
  int count = loadWiFiProfiles(profiles, WIFI_PROFILE_MAX);

  if (count == 0) return "None";

  String out;
  for (int i = 0; i < count; i++) {
    if (i > 0) out += ", ";
    out += profiles[i].ssid;
    if (profiles[i].primary) out += "*";
  }
  return out;
}

bool hasRequiredConfig() {
  return cfg.wifiSsid.length() > 0 &&
         cfg.apiUrl.length() > 0 &&
         cfg.deviceCode.length() > 0 &&
         cfg.deviceSecret.length() > 0;
}

// Forward declaration for helpers used by Local Admin functions.
// Required by PlatformIO/C++ because sendLocalAdminLogin() is defined before pageShell().
String pageShell(const String &title, const String &body);

String defaultAdminPin() {
  String code = cfg.deviceCode;
  code.replace("-", "");
  code.replace("_", "");
  code.trim();

  if (code.length() >= 6) {
    return code.substring(code.length() - 6);
  }

  return "123456";
}

String effectiveAdminPin() {
  String pin = cfg.adminPin;
  pin.trim();

  if (pin.length() >= 4) return pin;

  return defaultAdminPin();
}

bool isAdminAuthorized() {
  if (portalMode) return true;

  if (!server.hasArg("pin")) return false;

  String provided = server.arg("pin");
  provided.trim();

  return provided == effectiveAdminPin();
}

String currentPinValue() {
  if (portalMode) return "";
  if (!server.hasArg("pin")) return "";
  return htmlEscape(server.arg("pin"));
}

String pinHiddenInput() {
  if (portalMode) return "";
  return "<input type='hidden' name='pin' value='" + currentPinValue() + "'>";
}

void sendLocalAdminLogin(int statusCode = 200, String message = "") {
  String body;
  body += "<section class='card simple-card'><div class='section-kicker'>Protected setup</div><h2>เข้าสู่หน้าตั้งค่า ESP32</h2>";
  body += "<p class='muted'>อุปกรณ์ออนไลน์แล้ว กรอก Local Admin PIN เพื่อเปิดหน้าตั้งค่า Wi-Fi, Backend และ Device ของ ESP32 ตัวนี้.</p>";

  if (cfg.adminPin.length() == 0) {
    body += "<div class='notice info'>ยังไม่ได้ตั้ง Custom PIN ค่าเริ่มต้นคือ 6 ตัวท้ายของ Device Code จนกว่าจะตั้ง PIN ใหม่</div>";
  }

  if (message.length() > 0) {
    body += "<div class='notice'>" + htmlEscape(message) + "</div>";
  }

  body += "<form method='GET' action='/'><div class='form'>";
  body += "<label class='full'>Local Admin PIN<input type='password' name='pin' inputmode='numeric' autocomplete='current-password' placeholder='เช่น 123456'></label>";
  body += "</div><div class='row'><button type='submit'>เปิดหน้าตั้งค่า</button><a class='btn btn2' href='/json'>ดูสถานะ JSON</a></div></form>";
  body += "</section>";

  server.send(statusCode, "text/html; charset=utf-8", pageShell("ESP32 Local Admin", body));
}

bool requireAdmin() {
  if (portalMode) return true;

  if (isAdminAuthorized()) return true;

  sendLocalAdminLogin(403, "PIN ไม่ถูกต้อง หรือยังไม่ได้กรอก PIN");
  return false;
}

void setupDht() {
  if (dht != nullptr) {
    delete dht;
    dht = nullptr;
  }

  dht = new DHT(cfg.dhtPin, cfg.dhtType);
  dht->begin();
}

void updateStatusLed() {
  if (portalMode) {
    blinkLed(250);
    return;
  }

  if (WiFi.status() != WL_CONNECTED) {
    blinkLed(1000);
    return;
  }

  if (lastSendStatus == "ok") {
    setLed(true);
    return;
  }

  blinkLed(500);
}

void checkResetButton() {
  bool pressed = digitalRead(RESET_BUTTON_PIN) == LOW;

  if (pressed && resetButtonPressedAt == 0) {
    resetButtonPressedAt = millis();
    Serial.println("Reset button pressed. Hold 6 seconds to clear config.");
  }

  if (!pressed) {
    resetButtonPressedAt = 0;
    return;
  }

  if (resetButtonPressedAt > 0 && millis() - resetButtonPressedAt >= RESET_HOLD_MS) {
    Serial.println("Reset button held. Clearing config and restarting.");
    clearConfig();
    delay(500);
    ESP.restart();
  }
}

void checkSelfRecovery() {
  unsigned long now = millis();

  if (WiFi.status() != WL_CONNECTED) {
    if (wifiDisconnectedSince == 0) wifiDisconnectedSince = now;

    if (!portalMode && now - wifiDisconnectedSince > WIFI_RESTART_AFTER_MS) {
      Serial.println("Wi-Fi disconnected too long. Restarting ESP32.");
      ESP.restart();
    }
    return;
  }

  wifiDisconnectedSince = 0;

  if (!portalMode && lastSuccessfulSendAt > 0 && now - lastSuccessfulSendAt > SEND_RESTART_AFTER_MS) {
    Serial.println("No successful send for too long. Restarting ESP32.");
    ESP.restart();
  }
}

bool connectWiFi() {
  if (WiFi.status() == WL_CONNECTED) return true;

  WiFiProfile profiles[WIFI_PROFILE_MAX];
  int profileCount = loadWiFiProfiles(profiles, WIFI_PROFILE_MAX);
  if (profileCount == 0) return false;

  WiFi.mode(portalMode ? WIFI_AP_STA : WIFI_STA);
  WiFi.setAutoReconnect(true);
  WiFi.setSleep(false);

  Serial.println("Scanning Wi-Fi for remembered networks...");
  int networkCount = WiFi.scanNetworks(false, true);
  if (networkCount > 0) {
    for (int i = 0; i < profileCount; i++) profiles[i].rssi = -999;

    for (int n = 0; n < networkCount; n++) {
      String foundSsid = WiFi.SSID(n);
      int foundRssi = WiFi.RSSI(n);
      for (int i = 0; i < profileCount; i++) {
        if (profiles[i].ssid == foundSsid && foundRssi > profiles[i].rssi) {
          profiles[i].rssi = foundRssi;
        }
      }
    }
  } else {
    Serial.println("Wi-Fi scan found no networks. Trying primary remembered network.");
  }

  int order[WIFI_PROFILE_MAX];
  int orderCount = 0;

  for (int i = 0; i < profileCount; i++) {
    if (networkCount <= 0 || profiles[i].rssi > -999 || profiles[i].primary) {
      order[orderCount++] = i;
    }
  }

  for (int a = 0; a < orderCount - 1; a++) {
    for (int b = a + 1; b < orderCount; b++) {
      int ia = order[a];
      int ib = order[b];
      bool swapNeeded = false;

      // Always try the Wi-Fi explicitly selected by the user first.
      // Backup profiles are sorted by signal strength only after the primary profile.
      if (profiles[ia].primary != profiles[ib].primary) {
        swapNeeded = profiles[ib].primary;
      } else if (profiles[ib].rssi > profiles[ia].rssi) {
        swapNeeded = true;
      } else if (profiles[ia].rssi == -999 && profiles[ib].rssi > -999) {
        swapNeeded = true;
      }

      if (swapNeeded) {
        int tmp = order[a];
        order[a] = order[b];
        order[b] = tmp;
      }
    }
  }

  unsigned long connectStarted = millis();
  bool connected = false;
  int connectedProfileIndex = -1;

  for (int oi = 0; oi < orderCount; oi++) {
    int profileIndex = order[oi];
    WiFiProfile &profile = profiles[profileIndex];

    if (millis() - connectStarted > WIFI_CONNECT_TOTAL_TIMEOUT_MS) {
      Serial.println("Wi-Fi connect total timeout.");
      break;
    }

    Serial.print("Connecting remembered Wi-Fi: ");
    Serial.print(profile.ssid);
    if (profile.rssi > -999) {
      Serial.print(" RSSI=");
      Serial.print(profile.rssi);
    }
    Serial.println();

    WiFi.disconnect(false, false);
    delay(150);
    WiFi.begin(profile.ssid.c_str(), profile.password.c_str());

    unsigned long attemptStarted = millis();
    while (WiFi.status() != WL_CONNECTED &&
           millis() - attemptStarted < WIFI_PROFILE_ATTEMPT_TIMEOUT_MS &&
           millis() - connectStarted < WIFI_CONNECT_TOTAL_TIMEOUT_MS) {
      checkResetButton();
      updateStatusLed();
      delay(500);
      Serial.print(".");
    }
    Serial.println();

    if (WiFi.status() == WL_CONNECTED) {
      connected = true;
      connectedProfileIndex = profileIndex;
      break;
    }

    Serial.println("Remembered Wi-Fi attempt failed. Trying next profile if available.");
  }

  WiFi.scanDelete();

  if (connected && connectedProfileIndex >= 0) {
    WiFiProfile &connectedProfile = profiles[connectedProfileIndex];
    persistConnectedWiFiProfile(connectedProfile);

    Serial.print("Wi-Fi connected. SSID=");
    Serial.print(WiFi.SSID());
    Serial.print(" IP=");
    Serial.println(WiFi.localIP());
    Serial.print("RSSI=");
    Serial.println(WiFi.RSSI());
    Serial.print("Remembered Wi-Fi profiles=");
    Serial.println(knownWiFiProfileCount());

    wifiDisconnectedSince = 0;
    return true;
  }

  Serial.println("Wi-Fi connect failed for all remembered networks.");
  return false;
}

void setupTime() {
  if (WiFi.status() != WL_CONNECTED) return;

  configTime(0, 0, "pool.ntp.org", "time.nist.gov", "time.google.com");

  Serial.print("NTP sync");
  for (int i = 0; i < 20; i++) {
    struct tm timeinfo;
    if (getLocalTime(&timeinfo, 500)) {
      Serial.println(" OK");
      return;
    }
    Serial.print(".");
  }
  Serial.println(" timeout");
}

String isoTimestampOrEmpty() {
  struct tm timeinfo;
  if (!getLocalTime(&timeinfo, 20)) return "";

  char buffer[32];
  strftime(buffer, sizeof(buffer), "%Y-%m-%dT%H:%M:%SZ", &timeinfo);
  return String(buffer);
}

String pageShell(const String &title, const String &body) {
  String html;
  html.reserve(38000);
  String connectionClass = WiFi.status() == WL_CONNECTED ? "ok" : "bad";
  String connectionText = WiFi.status() == WL_CONNECTED ? "Wi-Fi connected" : "Setup mode";
  String activeIp = WiFi.status() == WL_CONNECTED ? WiFi.localIP().toString() : WiFi.softAPIP().toString();

  html += "<!doctype html><html lang='th'><head><meta charset='utf-8'>";
  html += "<meta name='viewport' content='width=device-width, initial-scale=1'>";
  html += "<title>dotWatch ESP32 Setup</title>";
  html += "<style>";
  html += ":root{color-scheme:dark;--bg:#0f172a;--bg2:#111827;--panel:#172033;--panel2:#1e293b;--panel3:#0b1220;--text:#f8fafc;--muted:#94a3b8;--soft:#cbd5e1;--border:#334155;--border2:rgba(148,163,184,.22);--primary:#ef4444;--primary2:#991b1b;--accent:#22c55e;--warn:#f59e0b;--danger:#ef4444;--info:#38bdf8;--shadow:0 24px 60px rgba(0,0,0,.34);}";
  html += "*{box-sizing:border-box}html{scroll-behavior:smooth}body{margin:0;min-height:100vh;background:radial-gradient(circle at 18% -10%,rgba(239,68,68,.18),transparent 28rem),radial-gradient(circle at 88% 10%,rgba(56,189,248,.12),transparent 25rem),linear-gradient(135deg,#0b1220,#111827 48%,#0f172a);color:var(--text);font-family:Inter,ui-sans-serif,system-ui,-apple-system,BlinkMacSystemFont,'Segoe UI',sans-serif;}";
  html += "a{color:inherit}.app-shell{max-width:1180px;margin:0 auto;padding:22px}.portal-frame{display:grid;grid-template-columns:270px minmax(0,1fr);gap:18px}.portal-sidebar{position:sticky;top:18px;height:calc(100vh - 36px);display:flex;flex-direction:column;gap:14px}.brand-card,.nav-card,.status-card,.card,.section-card,.page-hero{border:1px solid var(--border2);border-radius:24px;background:linear-gradient(180deg,rgba(30,41,59,.92),rgba(15,23,42,.92));box-shadow:var(--shadow);backdrop-filter:blur(10px)}";
  html += ".brand-card{padding:18px}.brand{display:flex;gap:12px;align-items:center}.logo{width:46px;height:46px;border-radius:16px;background:radial-gradient(circle at 28% 26%,#fff 0 7%,transparent 8%),linear-gradient(135deg,var(--primary),var(--primary2));box-shadow:0 16px 35px rgba(239,68,68,.24)}.brand-title{font-size:18px;font-weight:950;letter-spacing:-.04em}.brand-subtitle{color:var(--muted);font-size:12px;margin-top:2px;line-height:1.4}.nav-card{padding:12px}.nav-title{padding:8px 10px;color:var(--muted);font-size:11px;font-weight:950;letter-spacing:.12em;text-transform:uppercase}.side-nav{display:grid;gap:7px}.side-nav a{display:flex;align-items:center;justify-content:space-between;min-height:40px;padding:0 12px;border-radius:14px;text-decoration:none;color:var(--soft);font-size:13px;font-weight:900;border:1px solid transparent}.side-nav a:hover{border-color:var(--border2);background:rgba(148,163,184,.08)}.side-nav span{color:var(--muted);font-size:11px}.status-card{padding:14px;margin-top:auto}.status-row{display:flex;align-items:center;justify-content:space-between;gap:10px;margin-bottom:10px}.status-label{color:var(--muted);font-size:11px;font-weight:950;text-transform:uppercase;letter-spacing:.10em}.badge{display:inline-flex;align-items:center;gap:8px;min-height:32px;padding:0 11px;border-radius:999px;border:1px solid var(--border2);background:rgba(15,23,42,.72);color:var(--muted);font-size:12px;font-weight:950;white-space:nowrap}.dot{width:8px;height:8px;border-radius:999px;background:var(--warn)}.ok .dot{background:var(--accent)}.bad .dot{background:var(--danger)}.tiny{color:var(--muted);font-size:12px;line-height:1.5;word-break:break-word}";
  html += ".portal-main{min-width:0}.page-hero{padding:22px;margin-bottom:18px;display:flex;justify-content:space-between;gap:18px;align-items:flex-start}.eyebrow{display:inline-flex;align-items:center;gap:8px;color:#fecaca;font-size:12px;font-weight:950;letter-spacing:.10em;text-transform:uppercase}.page-hero h1{font-size:32px;line-height:1.08;margin:8px 0 8px;letter-spacing:-.055em}.page-hero p{margin:0;color:var(--muted);font-size:14px;line-height:1.55}.hero-actions{display:flex;gap:10px;flex-wrap:wrap;justify-content:flex-end}.grid{display:grid;grid-template-columns:minmax(0,1.55fr) minmax(300px,.85fr);gap:18px}.card,.section-card{padding:20px;margin-bottom:18px}.section-head{display:flex;align-items:flex-start;justify-content:space-between;gap:12px;margin-bottom:14px}.section-kicker{color:var(--muted);font-size:11px;font-weight:950;letter-spacing:.12em;text-transform:uppercase}.section-card h2,.card h2{margin:0;color:var(--text);font-size:20px;letter-spacing:-.035em}.section-desc,.muted{color:var(--muted);font-size:13px;line-height:1.55}.stat-grid{display:grid;grid-template-columns:repeat(3,minmax(0,1fr));gap:10px;margin-bottom:14px}.stat{min-height:86px;padding:13px;border:1px solid var(--border2);border-radius:18px;background:rgba(15,23,42,.62)}.stat small{display:block;color:var(--muted);font-size:11px;font-weight:950;letter-spacing:.04em;text-transform:uppercase}.stat strong{display:block;margin-top:7px;font-size:17px;line-height:1.25;word-break:break-word}.stat.good{border-color:rgba(34,197,94,.25);background:rgba(34,197,94,.08)}.stat.warn{border-color:rgba(245,158,11,.26);background:rgba(245,158,11,.08)}.stat.bad{border-color:rgba(239,68,68,.25);background:rgba(239,68,68,.08)}.form-section{border:1px solid var(--border2);border-radius:20px;padding:16px;background:rgba(15,23,42,.48);margin-top:12px}.form-section h3{margin:0 0 12px;font-size:15px;letter-spacing:-.02em}.form{display:grid;grid-template-columns:repeat(2,minmax(0,1fr));gap:12px}.full{grid-column:1/-1}label{display:grid;gap:7px;color:var(--soft);font-size:13px;font-weight:900}input,select,textarea{width:100%;border:1px solid var(--border2);border-radius:14px;background:#0b1220;color:var(--text);padding:12px 13px;outline:none}input:focus,select:focus,textarea:focus{border-color:rgba(239,68,68,.55);box-shadow:0 0 0 4px rgba(239,68,68,.12)}textarea{min-height:160px;resize:vertical;font-family:ui-monospace,SFMono-Regular,Menlo,Consolas,monospace;font-size:12px;line-height:1.45}.row{display:flex;gap:10px;flex-wrap:wrap;margin-top:16px}button,.btn{display:inline-flex;align-items:center;justify-content:center;min-height:42px;padding:0 15px;border:0;border-radius:14px;background:linear-gradient(135deg,var(--primary),var(--primary2));color:white;font-weight:950;text-decoration:none;cursor:pointer;box-shadow:0 14px 28px rgba(239,68,68,.16)}.btn2{background:rgba(15,23,42,.45);border:1px solid var(--border2);box-shadow:none;color:var(--soft)}.danger{background:rgba(239,68,68,.12);border:1px solid rgba(239,68,68,.28);color:#fecaca;box-shadow:none}.notice{padding:13px 14px;border-radius:17px;border:1px solid rgba(245,158,11,.28);background:rgba(245,158,11,.10);color:#fde68a;margin-bottom:16px;font-size:13px;line-height:1.55}.notice.info{border-color:rgba(56,189,248,.26);background:rgba(56,189,248,.08);color:#bae6fd}.ops-list{display:grid;gap:10px}.ops-item{display:flex;gap:10px;align-items:flex-start;padding:12px;border-radius:16px;border:1px solid var(--border2);background:rgba(15,23,42,.45)}.ops-icon{width:28px;height:28px;border-radius:10px;background:rgba(239,68,68,.14);display:flex;align-items:center;justify-content:center;color:#fecaca;font-weight:950}.footer{text-align:center;color:var(--muted);font-size:12px;margin:18px 0 4px}.quick-steps{display:grid;grid-template-columns:repeat(4,minmax(0,1fr));gap:10px;margin-bottom:18px}.quick-step{border:1px solid var(--border2);border-radius:18px;background:rgba(15,23,42,.55);padding:14px;display:flex;gap:12px;align-items:flex-start}.step-number{width:30px;height:30px;border-radius:12px;display:flex;align-items:center;justify-content:center;background:rgba(239,68,68,.16);color:#fecaca;font-weight:950;flex:0 0 auto}.quick-step strong{display:block;font-size:14px;margin-bottom:4px}.quick-step span{display:block;color:var(--muted);font-size:12px;line-height:1.45}.setup-summary{display:flex;justify-content:space-between;gap:14px;align-items:flex-start;padding:16px;border:1px solid var(--border2);border-radius:20px;background:rgba(15,23,42,.45);margin-bottom:14px}.setup-summary h2{margin:4px 0 4px}.stat em{display:block;margin-top:6px;color:var(--muted);font-size:11px;font-style:normal;line-height:1.35}.field-help{color:var(--muted);font-size:12px;line-height:1.45;margin-top:-2px}.friendly-list{grid-template-columns:repeat(2,minmax(0,1fr))}.advanced-card{border:1px solid var(--border2);border-radius:20px;background:rgba(15,23,42,.42);padding:0;margin-top:12px;overflow:hidden}.advanced-card>summary{list-style:none;cursor:pointer;padding:15px 16px;font-weight:950;color:var(--soft);display:flex;align-items:center;justify-content:space-between;gap:12px}.advanced-card>summary::-webkit-details-marker{display:none}.advanced-card>summary:after{content:'เปิด';font-size:11px;color:var(--muted);border:1px solid var(--border2);border-radius:999px;padding:5px 9px}.advanced-card[open]>summary:after{content:'ปิด'}.advanced-card .advanced-body{padding:0 16px 16px}.primary-action{min-width:220px}.danger-note{border-color:rgba(239,68,68,.25);background:rgba(239,68,68,.07)}";
  html += "@media(max-width:980px){.portal-frame{grid-template-columns:1fr}.quick-steps{grid-template-columns:repeat(2,minmax(0,1fr))}.friendly-list{grid-template-columns:1fr}.portal-sidebar{position:relative;top:auto;height:auto}.side-nav{grid-template-columns:repeat(3,minmax(0,1fr))}.status-card{margin-top:0}.grid{grid-template-columns:1fr}.page-hero{display:block}.hero-actions{justify-content:flex-start;margin-top:14px}.stat-grid{grid-template-columns:repeat(2,minmax(0,1fr))}}@media(max-width:620px){.app-shell{padding:12px}.side-nav{grid-template-columns:1fr}.form,.stat-grid,.quick-steps{grid-template-columns:1fr}.page-hero h1{font-size:26px}.brand-card,.nav-card,.status-card,.card,.section-card,.page-hero{border-radius:20px;padding:16px}}";
  html += R"DOTWATCHCSS(
.wifi-card{border-color:rgba(56,189,248,.28);background:linear-gradient(180deg,rgba(14,32,52,.96),rgba(15,23,42,.94))}
.wifi-card .section-kicker{color:#7dd3fc}.wifi-layout{display:grid;grid-template-columns:minmax(280px,.92fr) minmax(340px,1.08fr);gap:14px;align-items:start}
.wifi-form-panel,.wifi-scan-panel{border:1px solid var(--border2);border-radius:20px;background:rgba(11,18,32,.62);padding:15px;min-width:0}
.wifi-current{display:grid;grid-template-columns:repeat(3,minmax(0,1fr));gap:9px;margin-bottom:14px}.wifi-current-item{border:1px solid var(--border2);border-radius:16px;background:rgba(15,23,42,.72);padding:11px;min-width:0}.wifi-current-item small{display:block;color:var(--muted);font-size:10px;font-weight:950;letter-spacing:.08em;text-transform:uppercase}.wifi-current-item strong{display:block;margin-top:5px;font-size:13px;white-space:nowrap;overflow:hidden;text-overflow:ellipsis}
.wifi-guide{display:grid;grid-template-columns:repeat(3,minmax(0,1fr));gap:8px;margin:0 0 14px}.wifi-guide-item{display:flex;gap:8px;align-items:flex-start;padding:10px;border:1px dashed var(--border2);border-radius:15px;color:var(--muted);font-size:11px;line-height:1.45}.wifi-guide-number{width:23px;height:23px;border-radius:9px;background:rgba(56,189,248,.14);color:#7dd3fc;display:flex;align-items:center;justify-content:center;font-weight:950;flex:0 0 auto}
.password-wrap{display:grid;grid-template-columns:minmax(0,1fr) auto;gap:8px}.password-toggle{min-width:74px;min-height:46px;padding:0 11px;border:1px solid var(--border2);background:rgba(148,163,184,.08);box-shadow:none;color:var(--soft)}
.wifi-options{display:flex;align-items:flex-start;gap:9px;margin-top:11px;color:var(--muted);font-size:12px;line-height:1.45}.wifi-options input{width:18px;height:18px;flex:0 0 auto;margin:1px 0 0;accent-color:var(--primary)}
.wifi-primary{width:100%;margin-top:14px;min-height:48px}.wifi-danger-row{display:flex;align-items:center;justify-content:space-between;gap:12px;margin-top:12px;padding-top:12px;border-top:1px solid var(--border2)}.wifi-danger-row span{color:var(--muted);font-size:11px;line-height:1.4}.wifi-danger-row .danger{min-height:38px;padding:0 12px;white-space:nowrap}
.wifi-scan-head{display:flex;align-items:center;justify-content:space-between;gap:10px;margin-bottom:10px}.wifi-scan-head h3{margin:0;font-size:15px}.scan-button{min-height:38px;padding:0 12px;background:rgba(56,189,248,.10);border:1px solid rgba(56,189,248,.24);box-shadow:none;color:#bae6fd}.scan-button:disabled{opacity:.6;cursor:wait}
.wifi-scan-status{min-height:30px;display:flex;align-items:center;color:var(--muted);font-size:12px}.wifi-network-list{display:grid;gap:7px;max-height:325px;overflow:auto;padding-right:4px;scrollbar-width:thin;scrollbar-color:var(--border) transparent}.wifi-network{width:100%;min-height:52px;padding:8px 10px;border:1px solid var(--border2);border-radius:15px;background:rgba(15,23,42,.72);box-shadow:none;color:var(--text);display:grid;grid-template-columns:36px minmax(0,1fr) auto;gap:9px;align-items:center;text-align:left}.wifi-network:hover,.wifi-network.selected{border-color:rgba(56,189,248,.52);background:rgba(56,189,248,.10)}.wifi-signal{width:34px;height:34px;border-radius:12px;display:flex;align-items:flex-end;justify-content:center;gap:2px;padding:8px 6px;background:rgba(56,189,248,.10)}.wifi-signal i{display:block;width:3px;border-radius:3px;background:#334155}.wifi-signal i:nth-child(1){height:5px}.wifi-signal i:nth-child(2){height:9px}.wifi-signal i:nth-child(3){height:13px}.wifi-signal i:nth-child(4){height:17px}.wifi-signal.q1 i:nth-child(-n+1),.wifi-signal.q2 i:nth-child(-n+2),.wifi-signal.q3 i:nth-child(-n+3),.wifi-signal.q4 i:nth-child(-n+4){background:#38bdf8}.wifi-network-main{min-width:0}.wifi-network-name{font-size:13px;font-weight:950;white-space:nowrap;overflow:hidden;text-overflow:ellipsis}.wifi-network-meta{display:flex;gap:6px;flex-wrap:wrap;margin-top:4px;color:var(--muted);font-size:10px}.wifi-tag{display:inline-flex;align-items:center;min-height:20px;padding:0 7px;border:1px solid var(--border2);border-radius:999px}.wifi-tag.current{border-color:rgba(34,197,94,.28);color:#86efac;background:rgba(34,197,94,.08)}.wifi-tag.saved{border-color:rgba(56,189,248,.25);color:#bae6fd;background:rgba(56,189,248,.07)}.wifi-network-rssi{color:var(--muted);font-size:11px;white-space:nowrap}.wifi-selected-note{margin-top:9px;color:#bae6fd;font-size:11px;min-height:17px}.wifi-empty{padding:20px 12px;text-align:center;border:1px dashed var(--border2);border-radius:15px;color:var(--muted);font-size:12px;line-height:1.5}
.restart-card{text-align:center;padding:30px}.restart-icon{width:64px;height:64px;margin:0 auto 16px;border-radius:22px;display:flex;align-items:center;justify-content:center;background:rgba(34,197,94,.12);border:1px solid rgba(34,197,94,.26);color:#86efac;font-size:28px;font-weight:950}.restart-steps{display:grid;gap:8px;max-width:560px;margin:18px auto;text-align:left}.restart-step{display:flex;gap:10px;align-items:flex-start;padding:11px;border:1px solid var(--border2);border-radius:15px;background:rgba(15,23,42,.5)}
@media(max-width:820px){.wifi-layout{grid-template-columns:1fr}.wifi-current{grid-template-columns:repeat(3,minmax(0,1fr))}}
@media(max-width:620px){body{background:#0b1220}.app-shell{padding:0 0 12px}.portal-frame{gap:0}.portal-sidebar{position:sticky;top:0;z-index:50;display:grid;grid-template-columns:minmax(0,1fr);gap:0;height:auto;background:rgba(11,18,32,.96);backdrop-filter:blur(14px);border-bottom:1px solid var(--border2)}.brand-card{border:0;border-radius:0;box-shadow:none;background:transparent;padding:10px 14px}.brand{gap:9px}.logo{width:36px;height:36px;border-radius:12px}.brand-title{font-size:15px}.brand-subtitle{display:none}.nav-card{border:0;border-top:1px solid var(--border2);border-radius:0;box-shadow:none;background:transparent;padding:6px 8px}.nav-title{display:none}.side-nav{display:flex;gap:6px;overflow-x:auto;padding-bottom:2px;scrollbar-width:none}.side-nav::-webkit-scrollbar{display:none}.side-nav a{flex:0 0 auto;min-height:36px;padding:0 11px;border:1px solid var(--border2);background:rgba(15,23,42,.7);font-size:12px}.side-nav a span{display:none}.status-card{display:none}.portal-main{padding-top:0}.page-hero{border-radius:0 0 20px 20px;padding:16px 14px;margin:0 0 12px;border-left:0;border-right:0;box-shadow:none}.page-hero h1{font-size:25px}.page-hero p{font-size:12px}.hero-actions{display:grid;grid-template-columns:1fr 1fr;gap:8px}.hero-actions .btn{min-width:0;padding:0 9px;font-size:12px}.section-card,.card{margin:0 10px 12px;padding:15px;border-radius:19px;box-shadow:none}.wifi-current{grid-template-columns:1fr 1fr}.wifi-current-item:first-child{grid-column:1/-1}.wifi-guide{grid-template-columns:1fr}.wifi-form-panel,.wifi-scan-panel{padding:12px}.wifi-layout{gap:10px}.wifi-network-list{max-height:270px}.wifi-danger-row{align-items:flex-start;flex-direction:column}.wifi-danger-row .danger{width:100%}.password-wrap{grid-template-columns:minmax(0,1fr) 72px}.row{display:grid;grid-template-columns:1fr}.row button,.row .btn,.primary-action{width:100%;min-width:0}.setup-summary{display:grid}.stat-grid{grid-template-columns:1fr 1fr}.stat{min-height:78px}.stat strong{font-size:14px}.friendly-list{grid-template-columns:1fr}}
)DOTWATCHCSS";
  html += "</style></head><body><div class='app-shell'><div class='portal-frame'>";
  html += "<aside class='portal-sidebar'><section class='brand-card'><div class='brand'><div class='logo'></div><div><div class='brand-title'>dotWatch ESP32</div><div class='brand-subtitle'>DHT3 Local Device Console<br>";
  html += FIRMWARE_VERSION;
  html += "</div></div></div></section>";
  html += "<section class='nav-card'><div class='nav-title'>Setup menu</div><nav class='side-nav'><a href='#network'>Wi-Fi <span>01</span></a><a href='#overview'>ภาพรวม <span>02</span></a><a href='#device'>Device <span>03</span></a><a href='#security'>ความปลอดภัย <span>04</span></a><a href='#sensor'>เซนเซอร์ <span>05</span></a><a href='#operations'>บันทึก <span>06</span></a></nav></section>";
  html += "<section class='status-card'><div class='status-row'><div><div class='status-label'>Status</div><div class='tiny'>";
  html += htmlEscape(activeIp);
  html += "</div></div><span class='badge " + connectionClass + "'><span class='dot'></span>" + connectionText + "</span></div><div class='tiny'>Model: ESP32-DHT3 · TLS: ";
  html += htmlEscape(tlsModeText());
  html += "</div></section></aside>";
  html += "<main class='portal-main'><section class='page-hero'><div><div class='eyebrow'>Local Portal</div><h1>";
  html += htmlEscape(title);
  html += "</h1><p>ตั้งค่า ESP32 แบบง่ายสำหรับใช้งานจริง โดยคงโทนเดียวกับ Dashboard และยังแยกข้อมูลของอุปกรณ์ไว้เฉพาะ ESP32 ตัวนี้.</p></div><div class='hero-actions'><a class='btn' href='#network'>เปลี่ยน Wi-Fi</a><a class='btn btn2' href='/test'>ทดสอบเซนเซอร์</a></div></section>";
  html += body;
  html += "<div class='footer'>dotWatch ESP32 Local Portal · ใช้ตั้งค่าเฉพาะอุปกรณ์ตัวนี้</div></main>";
  html += R"DOTWATCHJS(
<script>
(function(){
  const byId = (id) => document.getElementById(id);
  const scanList = byId('wifiNetworkList');
  const scanStatus = byId('wifiScanStatus');
  const scanButton = byId('wifiScanButton');
  const ssidInput = byId('wifiSsid');
  const passwordInput = byId('wifiPassword');
  const selectedNote = byId('wifiSelectedNote');

  function signalClass(quality){
    if(quality >= 75) return 'q4';
    if(quality >= 50) return 'q3';
    if(quality >= 25) return 'q2';
    return 'q1';
  }

  function createTag(text, className){
    const tag = document.createElement('span');
    tag.className = 'wifi-tag' + (className ? ' ' + className : '');
    tag.textContent = text;
    return tag;
  }

  function selectNetwork(network, button){
    if(!ssidInput) return;
    ssidInput.value = network.ssid;
    document.querySelectorAll('.wifi-network').forEach((item) => item.classList.remove('selected'));
    if(button) button.classList.add('selected');
    if(selectedNote){
      selectedNote.textContent = network.secure
        ? 'เลือก ' + network.ssid + ' แล้ว กรุณากรอกรหัสผ่าน Wi-Fi'
        : 'เลือก ' + network.ssid + ' แล้ว เครือข่ายนี้ไม่ใช้รหัสผ่าน';
    }
    if(network.secure && passwordInput) passwordInput.focus();
  }

  function renderNetworks(networks){
    if(!scanList) return;
    scanList.innerHTML = '';
    if(!networks || networks.length === 0){
      const empty = document.createElement('div');
      empty.className = 'wifi-empty';
      empty.textContent = 'ไม่พบ Wi-Fi ใกล้เคียง ลองกดสแกนอีกครั้ง หรือพิมพ์ชื่อ Wi-Fi เอง';
      scanList.appendChild(empty);
      return;
    }

    networks.forEach((network) => {
      const button = document.createElement('button');
      button.type = 'button';
      button.className = 'wifi-network' + (network.current ? ' selected' : '');

      const signal = document.createElement('span');
      signal.className = 'wifi-signal ' + signalClass(network.quality || 0);
      signal.innerHTML = '<i></i><i></i><i></i><i></i>';

      const main = document.createElement('span');
      main.className = 'wifi-network-main';
      const name = document.createElement('span');
      name.className = 'wifi-network-name';
      name.textContent = network.ssid;
      const meta = document.createElement('span');
      meta.className = 'wifi-network-meta';
      meta.appendChild(createTag(network.secure ? 'มีรหัสผ่าน' : 'Open', ''));
      if(network.current) meta.appendChild(createTag('กำลังใช้งาน', 'current'));
      if(network.remembered && !network.current) meta.appendChild(createTag('เคยบันทึก', 'saved'));
      main.appendChild(name);
      main.appendChild(meta);

      const rssi = document.createElement('span');
      rssi.className = 'wifi-network-rssi';
      rssi.textContent = (network.rssi || 0) + ' dBm';

      button.appendChild(signal);
      button.appendChild(main);
      button.appendChild(rssi);
      button.addEventListener('click', () => selectNetwork(network, button));
      scanList.appendChild(button);
    });
  }

  window.scanDotWatchWifi = async function(){
    if(!scanList) return;
    if(scanButton) scanButton.disabled = true;
    if(scanStatus) scanStatus.textContent = 'กำลังสแกน Wi-Fi ใกล้เคียง...';
    try{
      const response = await fetch('/wifi-scan' + (window.location.search || ''), {cache:'no-store'});
      const data = await response.json();
      if(!response.ok || !data.ok) throw new Error(data.message || 'scan failed');
      renderNetworks(data.networks || []);
      if(scanStatus) scanStatus.textContent = 'พบ ' + (data.networks || []).length + ' เครือข่าย · แตะชื่อ Wi-Fi เพื่อเลือก';
    }catch(error){
      if(scanStatus) scanStatus.textContent = 'สแกนไม่สำเร็จ กรุณาลองอีกครั้ง หรือพิมพ์ชื่อ Wi-Fi เอง';
      renderNetworks([]);
    }finally{
      if(scanButton) scanButton.disabled = false;
    }
  };

  window.toggleDotWatchWifiPassword = function(){
    if(!passwordInput) return;
    const button = byId('wifiPasswordToggle');
    const show = passwordInput.type === 'password';
    passwordInput.type = show ? 'text' : 'password';
    if(button) button.textContent = show ? 'ซ่อน' : 'แสดง';
  };

  window.confirmDotWatchWifiChange = function(){
    if(!ssidInput || !ssidInput.value.trim()){
      alert('กรุณาเลือกหรือกรอกชื่อ Wi-Fi');
      if(ssidInput) ssidInput.focus();
      return false;
    }
    const original = ssidInput.getAttribute('data-current-ssid') || '';
    if(ssidInput.value.trim() !== original && passwordInput && passwordInput.value.length === 0){
      if(!confirm('Wi-Fi ใหม่ยังไม่มีรหัสผ่าน หากเครือข่ายมีรหัสผ่าน ESP32 จะเชื่อมต่อไม่ได้ ต้องการบันทึกต่อหรือไม่?')) return false;
    }
    return confirm('บันทึก Wi-Fi “' + ssidInput.value.trim() + '” และ Restart ESP32 ตอนนี้หรือไม่?');
  };

  document.addEventListener('DOMContentLoaded', function(){
    if(scanList) window.setTimeout(window.scanDotWatchWifi, 350);
  });
})();
</script>
)DOTWATCHJS";
  html += "</div></div></body></html>";
  return html;
}

String signalQualityText(int rssi) {
  if (WiFi.status() != WL_CONNECTED) return "ยังไม่เชื่อมต่อ";
  if (rssi >= -60) return "ดีมาก";
  if (rssi >= -70) return "ดี";
  if (rssi >= -80) return "พอใช้";
  return "สัญญาณอ่อน";
}

String lastSendLabel() {
  if (lastSendStatus == "ok") return "ส่งข้อมูลสำเร็จ";
  if (lastSendStatus == "error") return "ส่งไม่สำเร็จ";
  return "ยังไม่เคยส่ง";
}

String readyChecklistText() {
  int ready = 0;
  if (WiFi.status() == WL_CONNECTED) ready++;
  if (cfg.apiUrl.length() > 0) ready++;
  if (cfg.deviceCode.length() > 0 && cfg.deviceSecret.length() > 0) ready++;
  if (hasEffectiveTlsCaCert()) ready++;
  if (lastSendStatus == "ok") ready++;
  return String(ready) + "/5 พร้อมใช้งาน";
}

String currentStatusHtml() {
  String html;
  String wifiLabel = WiFi.status() == WL_CONNECTED ? WiFi.SSID() : "ยังไม่เชื่อมต่อ";
  String ipLabel = WiFi.status() == WL_CONNECTED ? WiFi.localIP().toString() : WiFi.softAPIP().toString();
  int rssi = WiFi.status() == WL_CONNECTED ? WiFi.RSSI() : 0;
  String sendClass = lastSendStatus == "ok" ? "good" : (lastSendStatus == "error" ? "bad" : "warn");
  String tlsClass = hasEffectiveTlsCaCert() ? "good" : "warn";

  html += "<div class='setup-summary'>";
  html += "<div><div class='section-kicker'>พร้อมใช้งาน</div><h2>" + readyChecklistText() + "</h2><p class='muted'>ดูสถานะสำคัญของ ESP32 ตัวนี้ในมุมมองเดียว ไม่ต้องเปิดหลายหน้า.</p></div>";
  html += "<span class='badge " + String(WiFi.status() == WL_CONNECTED ? "ok" : "bad") + "'><span class='dot'></span>" + String(WiFi.status() == WL_CONNECTED ? "ออนไลน์" : "Setup Mode") + "</span>";
  html += "</div>";

  html += "<div class='stat-grid'>";
  html += "<div class='stat " + String(WiFi.status() == WL_CONNECTED ? "good" : "warn") + "'><small>Wi-Fi</small><strong>" + htmlEscape(wifiLabel) + "</strong><em>เครือข่ายที่อุปกรณ์ใช้อยู่</em></div>";
  html += "<div class='stat'><small>IP Address</small><strong>" + htmlEscape(ipLabel) + "</strong><em>ใช้เปิดหน้านี้ในวง Wi-Fi เดียวกัน</em></div>";
  html += "<div class='stat'><small>Signal</small><strong>" + signalQualityText(rssi) + "</strong><em>RSSI " + String(rssi) + " dBm</em></div>";
  html += "<div class='stat'><small>Device Code</small><strong>" + htmlEscape(cfg.deviceCode.length() ? cfg.deviceCode : "ยังไม่ได้ตั้ง") + "</strong><em>รหัสอุปกรณ์บน dotWatch</em></div>";
  html += "<div class='stat " + tlsClass + "'><small>HTTPS / TLS</small><strong>" + htmlEscape(tlsCaCertSourceText()) + "</strong><em>" + htmlEscape(tlsModeText()) + "</em></div>";
  html += "<div class='stat " + sendClass + "'><small>ส่งข้อมูลล่าสุด</small><strong>" + lastSendLabel() + "</strong><em>HTTP " + String(lastHttpStatus) + " · OK " + String(totalSendOk) + " · FAIL " + String(totalSendFail) + "</em></div>";
  html += "</div>";

  html += "<div class='ops-list friendly-list'>";
  html += "<div class='ops-item'><div class='ops-icon'>1</div><div><strong>Wi-Fi ที่จำไว้</strong><div class='muted'>" + htmlEscape(knownWiFiProfileSummary()) + "</div></div></div>";
  html += "<div class='ops-item'><div class='ops-icon'>2</div><div><strong>Backend ปลายทาง</strong><div class='muted'>" + htmlEscape(cfg.apiUrl.length() ? cfg.apiUrl : "ยังไม่ได้ตั้ง Backend URL") + "</div></div></div>";
  html += "<div class='ops-item'><div class='ops-icon'>3</div><div><strong>Device Secret</strong><div class='muted'>" + htmlEscape(maskSecret(cfg.deviceSecret)) + "</div></div></div>";
  html += "<div class='ops-item'><div class='ops-icon'>4</div><div><strong>Local Admin PIN</strong><div class='muted'>" + String(cfg.adminPin.length() >= 4 ? "ตั้ง Custom PIN แล้ว" : "ใช้ค่าเริ่มต้น 6 ตัวท้ายของ Device Code") + "</div></div></div>";
  html += "<div class='ops-item'><div class='ops-icon'>5</div><div><strong>เซนเซอร์</strong><div class='muted'>Pin " + String(cfg.dhtPin) + " · " + String(cfg.dhtType == DHT22 ? "DHT22" : "DHT11") + " · ส่งทุก " + String(cfg.sendIntervalMs / 1000) + " วินาที</div></div></div>";
  html += "<div class='ops-item'><div class='ops-icon'>!</div><div><strong>ปัญหาล่าสุด</strong><div class='muted'>" + htmlEscape(lastSendError.length() ? lastSendError : "ยังไม่พบปัญหา") + "</div></div></div>";
  html += "</div>";
  return html;
}

void handleCaptive() {
  server.sendHeader("Location", String("http://") + WiFi.softAPIP().toString() + "/", true);
  server.send(302, "text/plain", "");
}

void handleJson() {
  if (!portalMode && !isAdminAuthorized()) {
    StaticJsonDocument<512> publicDoc;
    publicDoc["firmwareVersion"] = FIRMWARE_VERSION;
    publicDoc["modelKey"] = "esp32_dht3";
    publicDoc["wifiConnected"] = WiFi.status() == WL_CONNECTED;
    publicDoc["ip"] = WiFi.status() == WL_CONNECTED ? WiFi.localIP().toString() : WiFi.softAPIP().toString();
    publicDoc["localAdminProtected"] = true;
    publicDoc["message"] = "Open / and enter Local Admin PIN for full config.";
    String publicOut;
    serializeJsonPretty(publicDoc, publicOut);
    server.send(200, "application/json; charset=utf-8", publicOut);
    return;
  }

  StaticJsonDocument<1536> doc;
  doc["firmwareVersion"] = FIRMWARE_VERSION;
  doc["modelKey"] = "esp32_dht3";
  doc["wifiConnected"] = WiFi.status() == WL_CONNECTED;
  doc["ip"] = WiFi.status() == WL_CONNECTED ? WiFi.localIP().toString() : WiFi.softAPIP().toString();
  doc["wifiSsid"] = WiFi.status() == WL_CONNECTED ? WiFi.SSID() : cfg.wifiSsid;
  doc["rememberedWifiProfiles"] = knownWiFiProfileCount();
  doc["apiUrl"] = cfg.apiUrl;
  doc["deviceCode"] = cfg.deviceCode;
  doc["deviceSecretMasked"] = maskSecret(cfg.deviceSecret);
  doc["adminPinSet"] = cfg.adminPin.length() >= 4;
  doc["tlsMode"] = tlsModeText();
  doc["tlsCaCertSet"] = hasEffectiveTlsCaCert();
  doc["tlsCaCertSource"] = tlsCaCertSourceText();
  doc["tlsPortalCaCertSet"] = hasTlsCaCert();
  doc["tlsEmbeddedCaCertSet"] = hasEmbeddedTlsCaCert();
  doc["dhtPin"] = cfg.dhtPin;
  doc["dhtType"] = cfg.dhtType == DHT22 ? "DHT22" : "DHT11";
  doc["sendIntervalSeconds"] = cfg.sendIntervalMs / 1000;
  doc["rssi"] = WiFi.status() == WL_CONNECTED ? WiFi.RSSI() : 0;
  doc["uptime"] = uptimeText();
  doc["lastSendStatus"] = lastSendStatus;
  doc["lastSendError"] = lastSendError;
  doc["lastHttpStatus"] = lastHttpStatus;
  doc["totalSendOk"] = totalSendOk;
  doc["totalSendFail"] = totalSendFail;
  doc["statusLedPin"] = STATUS_LED_PIN;
  doc["resetButtonPin"] = RESET_BUTTON_PIN;

  String out;
  serializeJsonPretty(doc, out);
  server.send(200, "application/json; charset=utf-8", out);
}

bool readMetrics(float &temperature, float &humidity, int &rssi) {
  if (dht == nullptr) setupDht();

  temperature = dht->readTemperature();
  humidity = dht->readHumidity();
  rssi = WiFi.status() == WL_CONNECTED ? WiFi.RSSI() : 0;

  if (!isnan(temperature) && !isnan(humidity)) return true;

  if (cfg.fallbackDummy) {
    temperature = 24.0 + random(0, 800) / 100.0;
    humidity = 45.0 + random(0, 2000) / 100.0;
    return true;
  }

  return false;
}

void handleTest() {
  if (!requireAdmin()) return;

  float temperature = NAN;
  float humidity = NAN;
  int rssi = 0;
  bool ok = readMetrics(temperature, humidity, rssi);

  String body = "<section class='section-card'><div class='section-head'><div><div class='section-kicker'>Live sensor</div><h2>Read Test</h2><div class='section-desc'>อ่านค่าจาก DHT และ Wi-Fi RSSI แบบเดียวกับ payload ที่ส่งเข้า backend.</div></div></div>";
  if (ok) {
    body += "<div class='stat-grid'>";
    body += "<div class='stat good'><small>metric_1 Temperature</small><strong>" + String(temperature, 2) + " °C</strong></div>";
    body += "<div class='stat good'><small>metric_2 Humidity</small><strong>" + String(humidity, 2) + " %</strong></div>";
    body += "<div class='stat'><small>metric_3 Wi-Fi RSSI</small><strong>" + String(rssi) + " dBm</strong></div>";
    body += "</div>";
  } else {
    body += "<div class='notice'>DHT read failed and fallback dummy is disabled.</div>";
  }
  body += "<div class='row'><a class='btn btn2' href='/'>Back to ESP32 Console</a><a class='btn btn2' href='/json'>Status JSON</a></div></section>";
  server.send(200, "text/html; charset=utf-8", pageShell("Read Test", body));
}

int wifiQualityPercent(int rssi) {
  int quality = 2 * (rssi + 100);
  if (quality < 0) quality = 0;
  if (quality > 100) quality = 100;
  return quality;
}

bool isRememberedWiFi(const String &ssid) {
  WiFiProfile profiles[WIFI_PROFILE_MAX];
  int count = loadWiFiProfiles(profiles, WIFI_PROFILE_MAX);
  for (int i = 0; i < count; i++) {
    if (profiles[i].ssid == ssid) return true;
  }
  return false;
}

void handleWiFiScan() {
  if (!portalMode && !isAdminAuthorized()) {
    server.send(403, "application/json; charset=utf-8", "{\"ok\":false,\"message\":\"Local Admin PIN required\"}");
    return;
  }

  struct ScanItem {
    String ssid;
    int rssi;
    bool secure;
  };

  const int MAX_SCAN_RESULTS = 20;
  ScanItem items[MAX_SCAN_RESULTS];
  int itemCount = 0;

  int networkCount = WiFi.scanNetworks(false, true);
  if (networkCount > 0) {
    for (int i = 0; i < networkCount; i++) {
      String ssid = WiFi.SSID(i);
      ssid.trim();
      if (ssid.length() == 0) continue;

      int existingIndex = -1;
      for (int j = 0; j < itemCount; j++) {
        if (items[j].ssid == ssid) {
          existingIndex = j;
          break;
        }
      }

      int rssi = WiFi.RSSI(i);
      bool secure = WiFi.encryptionType(i) != WIFI_AUTH_OPEN;
      if (existingIndex >= 0) {
        if (rssi > items[existingIndex].rssi) {
          items[existingIndex].rssi = rssi;
          items[existingIndex].secure = secure;
        }
        continue;
      }

      if (itemCount < MAX_SCAN_RESULTS) {
        items[itemCount].ssid = ssid;
        items[itemCount].rssi = rssi;
        items[itemCount].secure = secure;
        itemCount++;
      }
    }
  }
  WiFi.scanDelete();

  for (int a = 0; a < itemCount - 1; a++) {
    for (int b = a + 1; b < itemCount; b++) {
      if (items[b].rssi > items[a].rssi) {
        ScanItem tmp = items[a];
        items[a] = items[b];
        items[b] = tmp;
      }
    }
  }

  JsonDocument doc;
  doc["ok"] = true;
  doc["count"] = itemCount;
  JsonArray networks = doc["networks"].to<JsonArray>();
  String currentSsid = WiFi.status() == WL_CONNECTED ? WiFi.SSID() : "";

  WiFiProfile rememberedProfiles[WIFI_PROFILE_MAX];
  int rememberedCount = loadWiFiProfiles(rememberedProfiles, WIFI_PROFILE_MAX);

  for (int i = 0; i < itemCount; i++) {
    bool remembered = false;
    for (int p = 0; p < rememberedCount; p++) {
      if (rememberedProfiles[p].ssid == items[i].ssid) {
        remembered = true;
        break;
      }
    }

    JsonObject item = networks.add<JsonObject>();
    item["ssid"] = items[i].ssid;
    item["rssi"] = items[i].rssi;
    item["quality"] = wifiQualityPercent(items[i].rssi);
    item["secure"] = items[i].secure;
    item["current"] = currentSsid.length() > 0 && items[i].ssid == currentSsid;
    item["remembered"] = remembered;
  }

  String out;
  serializeJson(doc, out);
  server.sendHeader("Cache-Control", "no-store, no-cache, must-revalidate");
  server.send(200, "application/json; charset=utf-8", out);
}

void handleWiFiSave() {
  if (!requireAdmin()) return;

  String ssid = server.hasArg("wifiSsid") ? server.arg("wifiSsid") : "";
  String password = server.hasArg("wifiPassword") ? server.arg("wifiPassword") : "";
  ssid.trim();

  if (ssid.length() == 0 || ssid.length() > 32) {
    String body = "<section class='card'><h2>ชื่อ Wi-Fi ไม่ถูกต้อง</h2><div class='notice'>กรุณาเลือกหรือกรอกชื่อ Wi-Fi ความยาวไม่เกิน 32 ตัวอักษร</div><div class='row'><a class='btn btn2' href='/#network'>กลับไปตั้งค่า Wi-Fi</a></div></section>";
    server.send(400, "text/html; charset=utf-8", pageShell("Wi-Fi Error", body));
    return;
  }

  if (password.length() > 63 || (password.length() > 0 && password.length() < 8)) {
    String body = "<section class='card'><h2>รหัสผ่าน Wi-Fi ไม่ถูกต้อง</h2><div class='notice'>รหัสผ่าน WPA/WPA2 ต้องมี 8–63 ตัวอักษร หรือเว้นว่างสำหรับเครือข่าย Open</div><div class='row'><a class='btn btn2' href='/#network'>กลับไปตั้งค่า Wi-Fi</a></div></section>";
    server.send(400, "text/html; charset=utf-8", pageShell("Wi-Fi Error", body));
    return;
  }

  Config next = cfg;
  String previousSsid = cfg.wifiSsid;
  previousSsid.trim();
  next.wifiSsid = ssid;

  // Blank password keeps the existing password only when the SSID is unchanged.
  if (password.length() > 0) {
    next.wifiPassword = password;
  } else if (ssid != previousSsid) {
    next.wifiPassword = "";
  }

  saveConfig(next);

  bool keepBackups = server.hasArg("keepWifiBackups");
  if (keepBackups) {
    rememberWiFiProfile(next.wifiSsid, next.wifiPassword);
  } else {
    WiFiProfile onlyPrimary[1];
    onlyPrimary[0].ssid = next.wifiSsid;
    onlyPrimary[0].password = next.wifiPassword;
    onlyPrimary[0].rssi = -999;
    onlyPrimary[0].primary = true;
    saveWiFiProfiles(onlyPrimary, 1);
  }

  String body;
  body += "<section class='card restart-card'><div class='restart-icon'>✓</div><div class='section-kicker'>Wi-Fi saved</div><h2>บันทึก Wi-Fi แล้ว</h2>";
  body += "<p class='muted'>ESP32 จะ Restart และพยายามเชื่อมต่อ <strong>" + htmlEscape(next.wifiSsid) + "</strong></p>";
  body += "<div class='restart-steps'>";
  body += "<div class='restart-step'><div class='step-number'>1</div><div><strong>รอประมาณ 15–30 วินาที</strong><div class='muted'>ไฟสถานะจะกระพริบระหว่างเชื่อมต่อ</div></div></div>";
  body += "<div class='restart-step'><div class='step-number'>2</div><div><strong>เชื่อมโทรศัพท์/คอมกลับเข้า Wi-Fi ปกติ</strong><div class='muted'>หากเชื่อมไม่สำเร็จ ESP32 จะเปิด dotWatch-ESP32-Setup อีกครั้ง</div></div></div>";
  body += "<div class='restart-step'><div class='step-number'>3</div><div><strong>เปิด Local IP หรือ Dashboard</strong><div class='muted'>ตรวจสอบว่าอุปกรณ์ Online และเริ่มส่งข้อมูลแล้ว</div></div></div>";
  body += "</div></section>";

  server.send(200, "text/html; charset=utf-8", pageShell("กำลังเปลี่ยน Wi-Fi", body));
  delay(1800);
  ESP.restart();
}

void handleWiFiClear() {
  if (!requireAdmin()) return;

  Config next = cfg;
  next.wifiSsid = "";
  next.wifiPassword = "";
  saveConfig(next);

  WiFiProfile emptyProfiles[1];
  saveWiFiProfiles(emptyProfiles, 0);

  String body;
  body += "<section class='card restart-card'><div class='restart-icon'>✓</div><div class='section-kicker'>Wi-Fi reset</div><h2>ล้าง Wi-Fi ที่จำไว้แล้ว</h2>";
  body += "<p class='muted'>ข้อมูล Backend, Device Code, Device Secret และ Sensor ยังอยู่ครบ</p>";
  body += "<div class='notice info'>หลัง Restart ให้เชื่อม <strong>dotWatch-ESP32-Setup</strong> ด้วยรหัส <strong>dotwatch-setup</strong> แล้วเปิด http://192.168.4.1/</div></section>";
  server.send(200, "text/html; charset=utf-8", pageShell("ล้าง Wi-Fi", body));
  delay(1800);
  ESP.restart();
}

void handleRoot() {
  if (!portalMode && !isAdminAuthorized()) {
    sendLocalAdminLogin();
    return;
  }

  String body;
  if (!hasRequiredConfig()) {
    body += "<div class='notice'>ตั้งค่ายังไม่ครบ เริ่มจากเลือก Wi-Fi ด้านล่าง แล้วตั้ง Backend และ Device Code/Secret</div>";
  }

  String activeSsid = WiFi.status() == WL_CONNECTED ? WiFi.SSID() : cfg.wifiSsid;
  String activeIp = WiFi.status() == WL_CONNECTED ? WiFi.localIP().toString() : WiFi.softAPIP().toString();
  String activeSignal = WiFi.status() == WL_CONNECTED ? signalQualityText(WiFi.RSSI()) : "Setup Mode";

  body += "<section id='network' class='section-card wifi-card'><div class='section-head'><div><div class='section-kicker'>Wi-Fi Quick Setup</div><h2>เปลี่ยน Wi-Fi ได้จากหน้านี้โดยตรง</h2><div class='section-desc'>กดสแกน เลือกชื่อ Wi-Fi ใส่รหัสผ่าน แล้วบันทึก ไม่ต้องล้าง Device Code หรือ Factory Reset.</div></div><span class='badge " + String(WiFi.status() == WL_CONNECTED ? "ok" : "bad") + "'><span class='dot'></span>" + String(WiFi.status() == WL_CONNECTED ? "Connected" : "Setup") + "</span></div>";

  body += "<div class='wifi-current'>";
  body += "<div class='wifi-current-item'><small>Wi-Fi ปัจจุบัน</small><strong>" + htmlEscape(activeSsid.length() ? activeSsid : "ยังไม่ได้ตั้ง") + "</strong></div>";
  body += "<div class='wifi-current-item'><small>IP Address</small><strong>" + htmlEscape(activeIp) + "</strong></div>";
  body += "<div class='wifi-current-item'><small>Signal</small><strong>" + htmlEscape(activeSignal) + "</strong></div>";
  body += "</div>";

  body += "<div class='wifi-guide'>";
  body += "<div class='wifi-guide-item'><div class='wifi-guide-number'>1</div><div><strong>สแกน</strong><br>รอรายชื่อ Wi-Fi ด้านขวา</div></div>";
  body += "<div class='wifi-guide-item'><div class='wifi-guide-number'>2</div><div><strong>เลือก</strong><br>แตะชื่อเครือข่ายที่ต้องการ</div></div>";
  body += "<div class='wifi-guide-item'><div class='wifi-guide-number'>3</div><div><strong>บันทึก</strong><br>ใส่รหัสผ่านและ Restart</div></div>";
  body += "</div>";

  body += "<div class='wifi-layout'><div class='wifi-form-panel'>";
  body += "<form method='POST' action='/wifi-save' onsubmit='return confirmDotWatchWifiChange()'>" + pinHiddenInput();
  body += "<div class='form'>";
  body += "<label class='full'>ชื่อ Wi-Fi (SSID)<input id='wifiSsid' data-current-ssid='" + htmlEscape(cfg.wifiSsid) + "' name='wifiSsid' value='" + htmlEscape(cfg.wifiSsid) + "' maxlength='32' autocomplete='off' placeholder='แตะเลือกจากรายการ หรือพิมพ์เอง'></label>";
  body += "<label class='full'>รหัสผ่าน Wi-Fi<div class='password-wrap'><input id='wifiPassword' type='password' name='wifiPassword' maxlength='63' autocomplete='new-password' placeholder='เว้นว่างไว้เมื่อใช้ Wi-Fi เดิม'><button id='wifiPasswordToggle' class='password-toggle' type='button' onclick='toggleDotWatchWifiPassword()'>แสดง</button></div></label>";
  body += "</div>";
  body += "<div id='wifiSelectedNote' class='wifi-selected-note'>เลือก Wi-Fi จากรายการด้านขวาเพื่อกรอกชื่ออัตโนมัติ</div>";
  body += "<label class='wifi-options'><input type='checkbox' name='keepWifiBackups' value='true' checked><span>เก็บ Wi-Fi เดิมไว้เป็นเครือข่ายสำรอง กรณีเครือข่ายใหม่ใช้งานไม่ได้</span></label>";
  body += "<button class='wifi-primary' type='submit'>บันทึก Wi-Fi และ Restart</button>";
  body += "</form>";
  body += "<div class='wifi-danger-row'><span>ล้างเฉพาะ Wi-Fi โดยไม่ลบ Device และ Backend</span><form method='POST' action='/wifi-clear' onsubmit='return confirm(\"ล้าง Wi-Fi ที่จำไว้ทั้งหมดหรือไม่?\")'>" + pinHiddenInput() + "<button class='danger' type='submit'>ล้าง Wi-Fi</button></form></div>";
  body += "</div>";

  body += "<div class='wifi-scan-panel'><div class='wifi-scan-head'><div><h3>Wi-Fi ใกล้เคียง</h3><div class='muted'>รายชื่อที่ ESP32 มองเห็นจริง</div></div><button id='wifiScanButton' class='scan-button' type='button' onclick='scanDotWatchWifi()'>สแกนใหม่</button></div>";
  body += "<div id='wifiScanStatus' class='wifi-scan-status'>กำลังเตรียมสแกน...</div><div id='wifiNetworkList' class='wifi-network-list'><div class='wifi-empty'>กำลังโหลดรายชื่อ Wi-Fi</div></div></div></div>";
  body += "</section>";

  body += "<section id='overview' class='section-card'><div class='section-head'><div><div class='section-kicker'>Device Status</div><h2>สถานะ ESP32</h2><div class='section-desc'>ตรวจสถานะเครือข่าย Backend Device และ Sensor ในมุมมองเดียว.</div></div><span class='badge " + String(WiFi.status() == WL_CONNECTED ? "ok" : "bad") + "'><span class='dot'></span>" + String(WiFi.status() == WL_CONNECTED ? "Online" : "Setup") + "</span></div>";
  body += currentStatusHtml();
  body += "</section>";

  body += "<form method='POST' action='/save'>" + pinHiddenInput();

  body += "<section id='device' class='section-card'><div class='section-head'><div><div class='section-kicker'>Device Connection</div><h2>เชื่อม dotWatch Backend และ Device</h2><div class='section-desc'>แก้ส่วนนี้เฉพาะเมื่อเปลี่ยน Backend หรือผูก ESP32 กับ Device ใหม่.</div></div></div>";
  body += "<div class='form'>";
  body += "<label class='full'>Backend API URL<input name='apiUrl' value='" + htmlEscape(cfg.apiUrl) + "' placeholder='https://dotwatch-backend.onrender.com'></label>";
  body += "<label>Device Code<input name='deviceCode' value='" + htmlEscape(cfg.deviceCode) + "' placeholder='DW-ESP32-...'></label>";
  body += "<label>Device Secret<input type='password' name='deviceSecret' value='' placeholder='เว้นว่างไว้ถ้าไม่เปลี่ยน Secret เดิม'></label>";
  body += "<div class='field-help full'>Device Code/Secret ต้องเป็นของ ESP32-DHT3 ตัวนี้เท่านั้น ไม่ใช้ร่วมกับ Raspberry Pi หรืออุปกรณ์อื่น.</div>";
  body += "</div></section>";

  body += "<details id='security' class='advanced-card'><summary>ตั้งค่าความปลอดภัย / Root CA / Local Admin PIN</summary><div class='advanced-body'>";
  body += "<div class='section-desc'>โดยปกติไม่ต้องแก้ส่วนนี้ ถ้า Backend ใช้ HTTPS ระบบต้องมี Root CA จาก embedded firmware หรือจากช่องด้านล่าง.</div>";
  body += "<div class='form-section'><h3>Root CA</h3><div class='form'>";
  body += "<label class='full'>Root CA Certificate (optional)<textarea name='tlsCaCert' placeholder='เว้นว่างเพื่อใช้ค่าเดิม/embedded CA · พิมพ์ CLEAR เพื่อลบ CA ที่บันทึกใน portal'></textarea></label>";
  body += "<div class='notice info full'>TLS ปัจจุบัน: " + htmlEscape(tlsModeText()) + " · Source: " + htmlEscape(tlsCaCertSourceText()) + "</div>";
  body += "</div></div>";
  body += "<div class='form-section'><h3>Local Admin PIN</h3><div class='form'>";
  body += "<label class='full'>ตั้ง PIN ใหม่<input type='password' name='adminPin' value='' placeholder='เว้นว่างเพื่อใช้ PIN เดิม'></label>";
  body += "<div class='field-help full'>ใช้สำหรับเปิดหน้านี้เมื่อ ESP32 ออนไลน์อยู่ในวง Wi-Fi เดียวกัน.</div>";
  body += "</div></div></div></details>";

  body += "<details id='sensor' class='advanced-card'><summary>ตั้งค่าเซนเซอร์ DHT และรอบส่งข้อมูล</summary><div class='advanced-body'>";
  body += "<div class='section-desc'>ค่าเริ่มต้นเหมาะกับ ESP32-DHT3 แล้ว ส่วนนี้มีไว้สำหรับเปลี่ยนชนิด DHT หรือรอบส่งข้อมูล.</div>";
  body += "<div class='form-section'><h3>DHT Settings</h3><div class='form'>";
  body += "<label>DHT Pin<input type='number' name='dhtPin' value='" + String(cfg.dhtPin) + "'></label>";
  body += "<label>DHT Type<select name='dhtType'>";
  body += "<option value='11'" + String(cfg.dhtType == DHT11 ? " selected" : "") + ">DHT11</option>";
  body += "<option value='22'" + String(cfg.dhtType == DHT22 ? " selected" : "") + ">DHT22</option>";
  body += "</select></label>";
  body += "<label>Send Interval<select name='sendIntervalSec'>";
  const int intervals[] = {10, 20, 30, 60, 120};
  for (int i = 0; i < 5; i++) {
    int sec = intervals[i];
    body += "<option value='" + String(sec) + "'" + String((cfg.sendIntervalMs / 1000) == (unsigned long)sec ? " selected" : "") + ">" + String(sec) + " sec</option>";
  }
  body += "</select></label>";
  body += "<label>Fallback Dummy<select name='fallbackDummy'>";
  body += "<option value='true'" + String(cfg.fallbackDummy ? " selected" : "") + ">Enabled</option>";
  body += "<option value='false'" + String(!cfg.fallbackDummy ? " selected" : "") + ">Disabled</option>";
  body += "</select></label>";
  body += "</div></div></div></details>";

  body += "<section id='operations' class='section-card'><div class='section-head'><div><div class='section-kicker'>Save Device Settings</div><h2>บันทึก Backend, Device และ Sensor</h2><div class='section-desc'>ปุ่มนี้ไม่จำเป็นเมื่อเปลี่ยนเฉพาะ Wi-Fi ใช้เฉพาะเมื่อแก้ข้อมูลส่วนด้านบน.</div></div></div>";
  body += "<div class='row'><button class='primary-action' type='submit'>บันทึกการตั้งค่า Device</button><a class='btn btn2' href='/test'>ทดสอบอ่านค่า</a><a class='btn btn2' href='/json'>ดูสถานะ JSON</a></div>";
  body += "</section></form>";

  body += "<details class='advanced-card danger-note'><summary>Factory Reset อุปกรณ์</summary><div class='advanced-body'>";
  body += "<div class='section-desc'>ล้าง Wi-Fi, Backend, Device Code/Secret, PIN และการตั้งค่า Sensor ทั้งหมด ใช้เมื่อเริ่มติดตั้งใหม่เท่านั้น.</div>";
  body += "<form method='POST' action='/reset' onsubmit='return confirm(\"ล้างการตั้งค่าทั้งหมดของ ESP32 หรือไม่?\")'>" + pinHiddenInput() + "<button class='danger' type='submit'>Factory Reset Config</button></form>";
  body += "</div></details>";

  server.send(200, "text/html; charset=utf-8", pageShell("ESP32 Device Console", body));
}

void handleSave() {
  if (!requireAdmin()) return;

  Config next = cfg;
  String previousWifiSsid = cfg.wifiSsid;

  if (server.hasArg("wifiSsid")) next.wifiSsid = server.arg("wifiSsid");
  if (server.hasArg("wifiPassword") && server.arg("wifiPassword").length() > 0) next.wifiPassword = server.arg("wifiPassword");
  if (server.hasArg("apiUrl")) next.apiUrl = normalizeApiUrl(server.arg("apiUrl"));
  if (server.hasArg("tlsCaCert")) {
    String tlsInput = server.arg("tlsCaCert");
    tlsInput.trim();
    if (tlsInput == "CLEAR") {
      next.tlsCaCert = "";
    } else if (tlsInput.length() > 0) {
      next.tlsCaCert = server.arg("tlsCaCert");
    }
  }
  if (server.hasArg("deviceCode")) next.deviceCode = server.arg("deviceCode");
  if (server.hasArg("deviceSecret") && server.arg("deviceSecret").length() > 0) next.deviceSecret = server.arg("deviceSecret");
  if (server.hasArg("adminPin") && server.arg("adminPin").length() > 0) next.adminPin = server.arg("adminPin");
  if (server.hasArg("dhtPin")) next.dhtPin = server.arg("dhtPin").toInt();
  if (server.hasArg("dhtType")) next.dhtType = server.arg("dhtType").toInt() == 22 ? DHT22 : DHT11;
  if (server.hasArg("sendIntervalSec")) {
    int sendIntervalSec = server.arg("sendIntervalSec").toInt();
    if (sendIntervalSec < 10) sendIntervalSec = 10;
    next.sendIntervalMs = (unsigned long)sendIntervalSec * 1000UL;
  }
  if (server.hasArg("fallbackDummy")) next.fallbackDummy = server.arg("fallbackDummy") == "true";

  next.wifiSsid.trim();
  previousWifiSsid.trim();
  if (next.wifiSsid != previousWifiSsid && (!server.hasArg("wifiPassword") || server.arg("wifiPassword").length() == 0)) {
    next.wifiPassword = "";
  }
  next.apiUrl = normalizeApiUrl(next.apiUrl);
  next.deviceCode.trim();
  next.deviceSecret.trim();
  next.adminPin.trim();
  next.tlsCaCert.trim();
  if (next.adminPin.length() > 0 && next.adminPin.length() < 4) {
    String body = "<section class='card'><h2>Invalid PIN</h2><div class='notice'>Local Admin PIN ต้องมีอย่างน้อย 4 ตัวอักษร</div><div class='row'><a class='btn btn2' href='/'>Back</a></div></section>";
    server.send(400, "text/html; charset=utf-8", pageShell("Invalid PIN", body));
    return;
  }

  if (next.tlsCaCert.length() > 0 && next.tlsCaCert.indexOf("BEGIN CERTIFICATE") < 0) {
    String body = "<section class='card'><h2>Invalid Root CA</h2><div class='notice'>Root CA certificate format ไม่ถูกต้อง ต้องเป็น PEM ที่มี BEGIN CERTIFICATE หรือพิมพ์ CLEAR เพื่อลบ</div><div class='row'><a class='btn btn2' href='/'>Back</a></div></section>";
    server.send(400, "text/html; charset=utf-8", pageShell("Invalid Root CA", body));
    return;
  }

  saveConfig(next);
  rememberWiFiProfile(next.wifiSsid, next.wifiPassword);

  String body = "<section class='card'><h2>Saved</h2><p class='muted'>บันทึกแล้ว กำลัง restart ESP32 ภายใน 2 วินาที</p><a class='btn btn2' href='/'>Back</a></section>";
  server.send(200, "text/html; charset=utf-8", pageShell("Saved", body));
  delay(1500);
  ESP.restart();
}

void handleReset() {
  if (!requireAdmin()) return;

  clearConfig();
  String body = "<section class='card'><h2>Config Cleared</h2><p class='muted'>ล้างค่าแล้ว กำลัง restart เข้าสู่ setup AP ใหม่</p></section>";
  server.send(200, "text/html; charset=utf-8", pageShell("Reset", body));
  delay(1500);
  ESP.restart();
}

void setupWebRoutes() {
  server.on("/", HTTP_GET, handleRoot);
  server.on("/wifi-scan", HTTP_GET, handleWiFiScan);
  server.on("/wifi-save", HTTP_POST, handleWiFiSave);
  server.on("/wifi-clear", HTTP_POST, handleWiFiClear);
  server.on("/save", HTTP_POST, handleSave);
  server.on("/reset", HTTP_POST, handleReset);
  server.on("/json", HTTP_GET, handleJson);
  server.on("/test", HTTP_GET, handleTest);
  server.on("/generate_204", HTTP_GET, handleCaptive);
  server.on("/gen_204", HTTP_GET, handleCaptive);
  server.on("/hotspot-detect.html", HTTP_GET, handleCaptive);
  server.on("/fwlink", HTTP_GET, handleCaptive);
  server.onNotFound([]() {
    if (portalMode) {
      handleCaptive();
      return;
    }
    server.send(404, "text/plain; charset=utf-8", "Not found");
  });
}

void setupPortal() {
  portalMode = true;

  WiFi.mode(WIFI_AP_STA);
  WiFi.softAP(SETUP_AP_SSID, SETUP_AP_PASSWORD);

  IPAddress apIp = WiFi.softAPIP();
  dnsServer.start(DNS_PORT, "*", apIp);

  Serial.print("Setup AP started. SSID=");
  Serial.println(SETUP_AP_SSID);
  Serial.print("Setup URL: http://");
  Serial.println(apIp);

  setupWebRoutes();
  server.begin();
}

void setupLocalAdminPortal() {
  portalMode = false;

  setupWebRoutes();
  server.begin();

  Serial.print("Local Admin URL: http://");
  Serial.print(WiFi.localIP());
  Serial.println("/");
  Serial.println("Local Admin is PIN protected.");
  if (cfg.adminPin.length() == 0) {
    Serial.println("Default PIN: last 6 characters of Device Code. Set a custom PIN in the portal.");
  }
}

bool postIngest(float temperature, float humidity, int rssi) {
  if (WiFi.status() != WL_CONNECTED) {
    Serial.println("POST skipped: Wi-Fi not connected");
    recordSendFail(0, "Wi-Fi not connected");
    return false;
  }

  if (!hasRequiredConfig()) {
    Serial.println("POST skipped: config incomplete");
    recordSendFail(0, "config incomplete");
    return false;
  }

  String endpoint = cfg.apiUrl + "/api/ingest";

  StaticJsonDocument<512> doc;
  doc["firmwareVersion"] = FIRMWARE_VERSION;

  String timestamp = isoTimestampOrEmpty();
  if (timestamp.length() > 0) doc["timestamp"] = timestamp;

  JsonObject metrics = doc.createNestedObject("metrics");
  metrics["metric_1"] = roundf(temperature * 100.0f) / 100.0f;
  metrics["metric_2"] = roundf(humidity * 100.0f) / 100.0f;
  metrics["metric_3"] = rssi;

  String body;
  serializeJson(doc, body);

  HTTPClient http;
  WiFiClientSecure secureClient;
  WiFiClient plainClient;

  bool beginOk = false;
  if (endpoint.startsWith("https://")) {
    if (hasEffectiveTlsCaCert()) {
      secureClient.setCACert(effectiveTlsCaCert());
      Serial.print("TLS mode: Root CA verification enabled, source=");
      Serial.println(tlsCaCertSourceText());
    } else {
#if DOTWATCH_ALLOW_INSECURE_TLS_FALLBACK
      secureClient.setInsecure();
      Serial.println("TLS mode: insecure fallback enabled by build flag");
#else
      Serial.println("POST skipped: HTTPS Root CA is required in production firmware");
      recordSendFail(0, "HTTPS Root CA is required");
      return false;
#endif
    }
    beginOk = http.begin(secureClient, endpoint);
  } else {
    Serial.println("TLS mode: plain HTTP");
    beginOk = http.begin(plainClient, endpoint);
  }

  if (!beginOk) {
    Serial.println("HTTP begin failed");
    recordSendFail(0, "HTTP begin failed");
    return false;
  }

  http.setTimeout(15000);
  http.addHeader("Accept", "application/json");
  http.addHeader("Content-Type", "application/json");
  http.addHeader("User-Agent", "dotwatch-esp32-dht3/" FIRMWARE_VERSION);
  http.addHeader("x-device-code", cfg.deviceCode);
  http.addHeader("x-device-secret", cfg.deviceSecret);

  int status = http.POST(body);
  String response = http.getString();

  Serial.print("POST status=");
  Serial.println(status);
  Serial.print("payload=");
  Serial.println(body);
  if (response.length()) {
    Serial.print("response=");
    Serial.println(response);
  }

  http.end();

  if (status >= 200 && status < 300) {
    recordSendOk(status);
    return true;
  }

  recordSendFail(status, response.length() ? response : "HTTP error");
  return false;
}

void setup() {
  Serial.begin(115200);
  delay(500);
  randomSeed(esp_random());

  pinMode(STATUS_LED_PIN, OUTPUT);
  pinMode(RESET_BUTTON_PIN, INPUT_PULLUP);
  setLed(false);

  Serial.println();
  Serial.println("dotWatch ESP32-DHT3 Hardened Firmware");
  Serial.print("Firmware: ");
  Serial.println(FIRMWARE_VERSION);
  Serial.println("Additional model only. Does not replace Raspberry Pi / DW20CH.");
  Serial.print("Status LED GPIO: ");
  Serial.println(STATUS_LED_PIN);
  Serial.print("Reset button GPIO: ");
  Serial.println(RESET_BUTTON_PIN);

  loadConfig();
  setupDht();

  bool wifiOk = connectWiFi();
  if (wifiOk) setupTime();

  if (!hasRequiredConfig() || !wifiOk) {
    setupPortal();
  } else {
    WiFi.mode(WIFI_STA);
    Serial.println("Normal send mode. Config portal is not active.");
    Serial.print("Device Code: ");
    Serial.println(cfg.deviceCode);
    Serial.print("Device Secret: ");
    Serial.println(maskSecret(cfg.deviceSecret));
    Serial.print("TLS Mode: ");
    Serial.println(tlsModeText());
    setupLocalAdminPortal();
  }
}

void loop() {
  checkResetButton();
  checkSelfRecovery();
  updateStatusLed();

  if (!portalMode) {
    server.handleClient();
  }

  if (portalMode) {
    dnsServer.processNextRequest();
    server.handleClient();

    if (hasRequiredConfig() && WiFi.status() != WL_CONNECTED && millis() - lastWifiRetryAt > PORTAL_RETRY_WIFI_MS) {
      lastWifiRetryAt = millis();
      connectWiFi();
      if (WiFi.status() == WL_CONNECTED) setupTime();
    }

    delay(2);
    return;
  }

  if (WiFi.status() != WL_CONNECTED) {
    connectWiFi();
    delay(1000);
    return;
  }

  unsigned long now = millis();
  if (now - lastSendAt < cfg.sendIntervalMs) {
    delay(250);
    return;
  }
  lastSendAt = now;

  float temperature = NAN;
  float humidity = NAN;
  int rssi = 0;

  if (!readMetrics(temperature, humidity, rssi)) {
    Serial.println("DHT read failed. Not sending.");
    recordSendFail(0, "DHT read failed");
    return;
  }

  Serial.print("SENT metric_1=");
  Serial.print(temperature, 2);
  Serial.print(" metric_2=");
  Serial.print(humidity, 2);
  Serial.print(" metric_3=");
  Serial.println(rssi);

  bool ok = postIngest(temperature, humidity, rssi);
  Serial.println(ok ? "SERVER_OK" : "SERVER_ERROR");
}
